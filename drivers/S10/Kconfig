## drivers/S10/Kconfig
```kconfig
menu "S10 linux device driver support package"

source "drivers/S10/device/Kconfig"
endmenu
```

## drivers/S10/device/Kconfig
```kconfig
#sensor unification for differ platform
menu "S10 linux device driver support package"

config S10_SENSORS_INPUT_INFO
	bool "S10 sensor input info"
	default n
	help
		get the S10 sensor input information.
source "drivers/S10/device/accelerometer/Kconfig"

source "drivers/S10/device/compass/Kconfig"

source "drivers/S10/device/light/Kconfig"

source "drivers/S10/device/gyroscope/Kconfig"

endmenu
```

## drivers/misc/audience/Kconfig
```kconfig
config AUDIENCE
	tristate "Audience Voice Processor Driver"
	default n
	help
		Say Y to enable Audience Voice Processor Support
```

## drivers/misc/sim/Kconfig
```kconfig
config SIM_DETECT
	bool "Sim card detect"
	default n
	help
	  Say Y here if you want to detect sim card.
```
